## examples/helloworld/Kconfig
```kconfig
config partition_examples_helloworld
	bool "helloworld app"
	depends on !partition_tests
	default y
	help
		hello world application example
```

## tests/Kconfig
```kconfig
config partition_tests
	bool "anckor test engine"
	default y
	help
		test engine

rsource "apps/Kconfig"
rsource "threads/Kconfig"
rsource "interrupt/Kconfig"
rsource "messages/Kconfig"
```

## tests/apps/Kconfig
```kconfig
config partition_tests_apps
	bool "test apps app"
	depends on partition_tests
	default n
	help
		test apps app
```

## tests/interrupt/Kconfig
```kconfig
config partition_tests_interrupt
	bool "test interrupt app"
	depends on partition_tests
	default y
	help
		test interrupt app
```

## tests/messages/Kconfig
```kconfig
config partition_tests_messages
	bool "test message app"
	depends on partition_tests
	default y
	help
		test messages api
```

## tests/threads/Kconfig
```kconfig
config partition_tests_threads
	bool "test threads app"
	depends on partition_tests
	default y
	help
		test threads app
```

## tools/defconfig/default_defconfig
```kconfig
#
# kernel
#
CONFIG_module_kernel=y
# end of kernel

#
# platform
#
CONFIG_module_platform=y
# end of platform

#
# arch
#
CONFIG_module_arch=y
# end of arch

#
# drv
#
CONFIG_module_drv_uart=y
# CONFIG_module_drv_timer is not set
# end of drv

#
# lib
#
CONFIG_module_lib_libc=y
# end of lib

#
# tests
#
CONFIG_partition_tests=y
CONFIG_partition_tests_apps=y
CONFIG_partition_tests_threads=y
CONFIG_partition_tests_interrupt=y
CONFIG_partition_tests_messages=y
# end of tests

#
# examples
#
# end of examples
```

## tools/defconfig/helloworld_defconfig
```kconfig
#
# kernel
#
CONFIG_module_kernel=y
# end of kernel

#
# platform
#
CONFIG_module_platform=y
# end of platform

#
# arch
#
CONFIG_module_arch=y
# end of arch

#
# drv
#
CONFIG_module_drv_uart=y
# CONFIG_module_drv_timer is not set
# end of drv

#
# lib
#
CONFIG_module_lib_libc=y
# end of lib

#
# tests
#
# CONFIG_partition_tests is not set
# end of tests

#
# examples
#
CONFIG_partition_examples_helloworld=y
# end of examples
```
