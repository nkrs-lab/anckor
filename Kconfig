## Kconfig
```kconfig
mainmenu "Anckor Kernel Configuration"

menu "kernel"

rsource "kernel/Kconfig"

endmenu

menu "platform"

rsource "platform/Kconfig"

endmenu

menu "arch"

rsource "arch/Kconfig"

endmenu

menu "drv"

rsource "drv/Kconfig"

endmenu

menu "lib"

rsource "lib/Kconfig"

endmenu

menu "tests"

rsource "tests/Kconfig"

endmenu

menu "examples"

rsource "examples/Kconfig"

endmenu
```
